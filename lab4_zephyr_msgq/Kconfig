## lab4_zephyr_msgq/Kconfig
```kconfig
menu "Lab 4: Message queue options"

config APP_SERVER_PRIORITY
    int "Server thread priority"
    default 1
    range 0 7
    help
      Ưu tiên của thread server (số nhỏ = ưu tiên cao).

config APP_CLIENT_PRIORITY
    int "Client thread priority"
    default 3
    range 0 7
    help
      Ưu tiên của thread client.

config APP_CLIENT_PERIOD_MS
    int "Khoảng gửi (ms) của client"
    default 50
    range 1 1000

config APP_SERVER_WORK_MS
    int "Server xử lý mô phỏng (ms)"
    default 10
    range 0 200

config APP_QUEUE_DEPTH
    int "Độ sâu k_msgq"
    default 8
    range 1 64

endmenu

source "Kconfig.zephyr"
```
